/*
 * servo.c
 *
 *  Created on: 2026-03-15
 *      Author: Daydreamer
 */

//-------------------------------------------头文件声明区------------------------------------------------------------
#include "zf_common_headfile.h"
#include "servo.h"

//-------------------------------------------宏定义区------------------------------------------------------------

#define middle_angle  96.5f                                     //宏定义真正的中值角度 94.5°
#define servo_center_angle  90.0f                               //宏定义舵机中心角度 90.0°
#define servo_angle_bias    (middle_angle - servo_center_angle) //宏定义舵机角度偏移量 4.5°

//-------------------------------------------内部变量声明区------------------------------------------------------------
static float g_current_angle = servo_center_angle;                            // 记录当前角度


//-------------------------------------------函数定义区------------------------------------------------------------

 ////-------------------------------------------------------------------------------------------------------------------
 ////  @brief      舵机角度转占空比计算函数
 ////  @param      angle - 输入角度
 ////-------------------------------------------------------------------------------------------------------------------
static uint32 calc_servo_duty(float angle)
{

    float period_ms = 1000.0f / (float)SERVO_FREQ;                      // 周期时间（毫秒）
    float high_time_ms = 0.5f + (angle / 90.0f);                        // 高电平时间（毫秒）

    if (high_time_ms < 0.0f)                             // 高电平时间不能小于0
    {
        high_time_ms = 0.0f;                             // 高电平时间不能小于0 ，则设为0
    }
    else if (high_time_ms > period_ms)                   // 高电平时间不能大于周期时间
    {
        high_time_ms = period_ms;                        // 高电平时间不能大于周期时间，则设为周期时间
    }

    float duty_val = ((float)PWM_DUTY_MAX * high_time_ms) / period_ms;// 计算占空比
    if (duty_val < 0.0f)
    {
        duty_val = 0.0f;
    }
    else if (duty_val > (float)PWM_DUTY_MAX)             // 占空比不能大于最大占空比
    {
        duty_val = (float)PWM_DUTY_MAX;                  // 占空比不能大于最大占空比，则设为最大占空比
    }

    return (uint32)(duty_val + 0.5f);                    // 四舍五入取整  防止强转截断
}


 ////-------------------------------------------------------------------------------------------------------------------
 ////  @brief      舵机初始化函数
 ////  @param      angle - 输入角度
 ////-------------------------------------------------------------------------------------------------------------------
void servo_init(void)
{
    uint32 init_duty = calc_servo_duty(middle_angle);                          // 初始占空比设为实际90 度对应的值
    pwm_init(SERVO_PIN, SERVO_FREQ, init_duty);                                 // 初始化 PWM 通道

    g_current_angle = servo_center_angle;                                     // 初始角度设为中心角度
}

 ////-------------------------------------------------------------------------------------------------------------------
 ////  @brief      舵机角度设置函数
 ////  @param      angle - 目标角度（0-180）
 ////-------------------------------------------------------------------------------------------------------------------
void servo_set_angle(float angle)
{
    // 1. 软件限幅保护
    if (angle < SERVO_ANGLE_MIN)                        // 限幅保护，防止角度超出范围  最小50
    {
        angle = SERVO_ANGLE_MIN;                        // 角度下限为50
    }
    else if (angle > SERVO_ANGLE_MAX)                   // 限幅保护，防止角度超出范围  最大150
    {
        angle = SERVO_ANGLE_MAX;                        // 角度上限为150
    }

    // 2. 更新全局记录
    g_current_angle = angle;                            // 记录当前角度 修正后的

    // 3. 计算并设置 PWM
    uint32 duty = calc_servo_duty(angle + servo_angle_bias);               //内部加角度偏移量 计算占空比
    pwm_set_duty(SERVO_PIN, duty);                      // 设置 PWM 占空比
}

 ////-------------------------------------------------------------------------------------------------------------------
 ////  @brief      舵机角度获取函数
 ////  @retval     float - 当前记录的角度（0-180）
 ////-------------------------------------------------------------------------------------------------------------------
float servo_get_angle(void)
{
    return g_current_angle;
}
 ////-------------------------------------------------------------------------------------------------------------------
 ////  @brief      舵机角度获取函数（弧度）
 ////  @retval
 ////-------------------------------------------------------------------------------------------------------------------

float servo_get_angle_rad_relative(void)
{
    return (g_current_angle - servo_center_angle) * 0.017453292519943295f;
}
